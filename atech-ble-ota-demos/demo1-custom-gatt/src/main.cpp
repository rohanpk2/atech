// Atech Demo 1: Web Bluetooth commands + custom GATT OTA.
// Prototype ONLY: transport CRCs detect accidents, not malicious firmware.
// Production devices require authenticated access and signed firmware.
//
// Application logic lives in src/app/user_app.cpp and runs on its own task
// through the protected Atech core (shared/AtechCore). Everything in this file
// is core behaviour and is never regenerated by the AI firmware builder.
#include <Arduino.h>
#include <AtechCloudOta.h>
#include <AtechCore.h>
#include <AtechWifiLan.h>
#include <AtechWifiOta.h>
#include <BLEDevice.h>
#include <BLEServer.h>
#include <BLEUtils.h>
#if defined(CONFIG_BLUEDROID_ENABLED)
#include <BLE2902.h>
#endif
#include <Update.h>
#include <freertos/FreeRTOS.h>
#include <freertos/queue.h>

#include "app/app_build.h"

#ifndef DEMO_VERSION
#define DEMO_VERSION 1
#endif

// Leave these empty to generate and persist device-specific credentials in
// NVS. Provisioned builds can override either value with quoted build flags.
#ifndef ATECH_WIFI_AP_PASSWORD
#define ATECH_WIFI_AP_PASSWORD ""
#endif
#ifndef ATECH_WIFI_OTA_TOKEN
#define ATECH_WIFI_OTA_TOKEN ""
#endif
// Cloud OTA: the builder backend's public origin, baked in by the backend for generated images
// (and by the installer for the base image); the hotspot portal can override it. Plain http://
// is refused unless ATECH_CLOUD_ALLOW_HTTP=1 (lab builds against a local backend).
#ifndef ATECH_CLOUD_URL
#define ATECH_CLOUD_URL ""
#endif
#ifndef ATECH_CLOUD_ALLOW_HTTP
#define ATECH_CLOUD_ALLOW_HTTP 0
#endif

#define ATECH_STR_(value) #value
#define ATECH_STR(value) ATECH_STR_(value)

#define LED_PIN 48 // Change to 38 if your board's RGB LED uses GPIO38.
#define WIFI_OTA_BUTTON_PIN 0 // ESP32-S3 DevKitC BOOT; sampled only after boot.
#define WIFI_LAN_PORT 8080    // Authenticated LAN OTA service (mDNS _atech-ota._tcp).
#define SERVICE_UUID  "a7ec0001-2e47-4dd2-82a4-9c2cf6eaa001"
#define CONTROL_UUID  "a7ec0002-2e47-4dd2-82a4-9c2cf6eaa001"
#define DATA_UUID     "a7ec0003-2e47-4dd2-82a4-9c2cf6eaa001"
#define STATUS_UUID   "a7ec0004-2e47-4dd2-82a4-9c2cf6eaa001"
#define INFO_UUID     "a7ec0005-2e47-4dd2-82a4-9c2cf6eaa001"
#define COMMAND_UUID  "a7ec0006-2e47-4dd2-82a4-9c2cf6eaa001"
#define RESPONSE_UUID "a7ec0007-2e47-4dd2-82a4-9c2cf6eaa001"

constexpr uint16_t ESP32_S3_CHIP_ID = 9;
constexpr uint32_t OTA_IDLE_TIMEOUT_MS = 30000;
constexpr uint32_t WIFI_OTA_INACTIVITY_TIMEOUT_MS = 10UL * 60UL * 1000UL;
constexpr uint32_t WIFI_OTA_BUTTON_HOLD_MS = 3000;
constexpr uint32_t AUTO_CONFIRM_MS = 20000;
constexpr uint8_t COMMAND_PROTOCOL_VERSION = 1;
constexpr size_t COMMAND_PACKET_SIZE = 20;
constexpr char WIFI_OTA_IMAGE_IDENTITY[] = "ATECH-OTA-APP-DEMO1";
constexpr char BLE_NAME_PREFIX[] = "Atech-Custom-OTA";

// Stock images report "Atech demo1 / v1 / blue default" and "... / v2 / green
// default"; AI builds report their backend-assigned version and app name.
constexpr char FIRMWARE_INFO[] =
    "Atech demo1 / v" ATECH_STR(ATECH_APP_VERSION) " / " ATECH_APP_NAME;
// Embedded so the backend can prove a firmware.bin belongs to its build job.
constexpr char BUILD_MARKER[] = "ATECH-BUILD:" ATECH_BUILD_ID;
// Embedded so a receiving board can refuse an image built for another board.
constexpr char TARGET_MARKER[] = "ATECH-TARGET:" ATECH_TARGET_DEVICE_ID;

enum class FrameKind : uint8_t { OtaControl, OtaData, Command };
enum class CommandOpcode : uint8_t {
  Ping = 0x01,
  BlinkBlue = 0x02,
  BlinkGreen = 0x03,
  StopBlinking = 0x04,
  GetStatus = 0x05,
  ResumeApp = 0x06,
};
enum class CommandStatus : uint8_t {
  Ok = 0,
  Malformed = 1,
  CrcError = 2,
  Unsupported = 3,
  Busy = 4,
};

// OTA data may use the negotiated 247-byte MTU (244-byte ATT payload).
struct Frame {
  FrameKind kind;
  uint16_t length;
  uint8_t bytes[244];
};

QueueHandle_t incoming;
BLECharacteristic *statusCharacteristic = nullptr;
BLECharacteristic *responseCharacteristic = nullptr;
BLEServer *bleServer = nullptr;
volatile bool deviceConnected = false;
volatile bool disconnectPending = false;
bool previouslyConnected = false;
AtechWifiOtaPortal wifiOta;
AtechWifiLan wifiLan;
AtechCloudOta cloudOta;
bool wifiOtaModeActive = false;
bool wifiUploadWasActive = false;
bool lanTransferWasActive = false;
String bleDeviceName;

bool updating = false;
uint32_t expectedSize = 0;
uint32_t expectedCRC = 0;
uint32_t runningCRC = 0xFFFFFFFFUL;
uint32_t received = 0;
uint32_t lastActivityMs = 0;

bool bleBlocksWifiOta() {
  // Entering Wi-Fi mode never evicts a connected BLE client and never aborts
  // a BLE update. Release the button, disconnect, then hold it again.
  return updating || deviceConnected || wifiLan.isTransferring() || cloudOta.isTransferring();
}

bool otaTransportBusy() {
  return updating || wifiOtaModeActive || wifiLan.isTransferring() || cloudOta.isTransferring();
}

// The LAN service may not start while BLE, the hotspot portal or the cloud
// agent owns flash. A merely connected BLE client does not block it; commands
// answer Busy.
bool lanBlockedByOthers() {
  return updating || wifiOta.isUpdating() || cloudOta.isTransferring();
}

// The cloud agent may not start a download while any other transport owns flash.
bool cloudBlockedByOthers() {
  return updating || wifiOta.isUpdating() || wifiLan.isTransferring();
}

String lanAuthToken() {
  return wifiOta.otaToken();
}

bool cloudHoldsConfirm() { return cloudOta.holdsConfirm(); }
String cloudIdentity() { return cloudOta.statusJson(); }
bool homeWifiConnected() { return wifiLan.isConnected(); }

void handleWifiOtaModeChanged(bool active) {
  wifiOtaModeActive = active;
  if (!active && !updating) atech::coreResumeApp();
  if (!bleServer) return;
  if (active) {
    BLEDevice::stopAdvertising();
    if (incoming) xQueueReset(incoming);
    Serial.println("BLE advertising paused for exclusive Wi-Fi OTA mode");
  } else if (!deviceConnected && !updating) {
    bleServer->startAdvertising();
    Serial.println("BLE advertising resumed after Wi-Fi OTA mode");
  }
}

uint16_t le16(const uint8_t *bytes) {
  return uint16_t(bytes[0]) | (uint16_t(bytes[1]) << 8);
}

uint32_t le32(const uint8_t *bytes) {
  return uint32_t(bytes[0]) | (uint32_t(bytes[1]) << 8)
      | (uint32_t(bytes[2]) << 16) | (uint32_t(bytes[3]) << 24);
}

void putLe16(uint8_t *bytes, uint16_t value) {
  bytes[0] = uint8_t(value);
  bytes[1] = uint8_t(value >> 8);
}

void putLe32(uint8_t *bytes, uint32_t value) {
  bytes[0] = uint8_t(value);
  bytes[1] = uint8_t(value >> 8);
  bytes[2] = uint8_t(value >> 16);
  bytes[3] = uint8_t(value >> 24);
}

uint16_t crc16(const uint8_t *data, size_t length) {
  uint16_t crc = 0;
  for (size_t i = 0; i < length; ++i) {
    crc ^= uint16_t(data[i]) << 8;
    for (uint8_t bit = 0; bit < 8; ++bit) {
      crc = (crc & 0x8000) ? uint16_t((crc << 1) ^ 0x1021)
                           : uint16_t(crc << 1);
    }
  }
  return crc;
}

uint32_t crc32Update(uint32_t crc, const uint8_t *data, size_t length) {
  for (size_t i = 0; i < length; ++i) {
    crc ^= data[i];
    for (uint8_t bit = 0; bit < 8; ++bit) {
      crc = (crc >> 1) ^ ((crc & 1) ? 0xEDB88320UL : 0UL);
    }
  }
  return crc;
}

void notifyStatus(uint8_t code, uint32_t offset) {
  // OTA status: [event code, offset uint32 LE].
  uint8_t status[5] = {
    code, uint8_t(offset), uint8_t(offset >> 8),
    uint8_t(offset >> 16), uint8_t(offset >> 24)
  };
  statusCharacteristic->setValue(status, sizeof(status));
  statusCharacteristic->notify();
}

void notifyCommandResponse(uint32_t requestId, uint8_t opcode,
                           CommandStatus status, const uint8_t nonce[8]) {
  // Fixed 20-byte response, safe even with the minimum 23-byte ATT MTU:
  // version[1], request ID[4], opcode[1], status[1], LED mode[1],
  // nonce[8], firmware version[1], flags[1], CRC16[2].
  uint8_t response[COMMAND_PACKET_SIZE] = {};
  response[0] = COMMAND_PROTOCOL_VERSION;
  putLe32(&response[1], requestId);
  response[5] = opcode;
  response[6] = static_cast<uint8_t>(status);
  response[7] = static_cast<uint8_t>(atech::ledOwner());
  memcpy(&response[8], nonce, 8);
  response[16] = uint8_t(ATECH_APP_VERSION & 0xFF);
  response[17] = otaTransportBusy() ? 0x01 : 0x00;
  putLe16(&response[18], crc16(response, 18));
  responseCharacteristic->setValue(response, sizeof(response));
  responseCharacteristic->notify();
}

class InputCallbacks : public BLECharacteristicCallbacks {
public:
  explicit InputCallbacks(FrameKind inputKind) : kind(inputKind) {}

  void onWrite(BLECharacteristic *characteristic) override {
    const size_t length = characteristic->getLength();
    if (length == 0 || length > sizeof(Frame::bytes)) return;
    Frame frame = {};
    frame.kind = kind;
    frame.length = static_cast<uint16_t>(length);
    memcpy(frame.bytes, characteristic->getData(), length);
    if (xQueueSend(incoming, &frame, 0) != pdTRUE) {
      Serial.println("BLE input queue full");
    }
  }

private:
  FrameKind kind;
};

class ConnectionCallbacks : public BLEServerCallbacks {
  void onConnect(BLEServer *) override { deviceConnected = true; }
#if defined(CONFIG_NIMBLE_ENABLED)
  void onConnect(BLEServer *server, ble_gap_conn_desc *description) override {
    server->requestConnParams(description->conn_handle, 0x06, 0x12, 0, 2000);
  }
#elif defined(CONFIG_BLUEDROID_ENABLED)
  void onConnect(BLEServer *server, esp_ble_gatts_cb_param_t *parameters) override {
    server->updateConnParams(parameters->connect.remote_bda, 0x06, 0x12, 0, 2000);
  }
#endif
  void onDisconnect(BLEServer *) override {
    deviceConnected = false;
    disconnectPending = true;
  }
};

void abortUpdate(uint8_t code = 0xE0, bool sendStatus = true) {
  if (updating) Update.abort();
  updating = false;
  atech::coreReleaseOta("ble");
  if (!wifiOtaModeActive) atech::coreResumeApp();
  if (sendStatus && deviceConnected) notifyStatus(code, received);
}

void handleControl(const Frame &frame) {
  const uint8_t opcode = frame.bytes[0];
  if (opcode == 0x01 && frame.length == 9) { // START: opcode + size + CRC32
    if (otaTransportBusy()) { notifyStatus(0xE1, received); return; }
    if (!atech::coreTryAcquireOta("ble")) { notifyStatus(0xE1, received); return; }
    expectedSize = le32(&frame.bytes[1]);
    expectedCRC = le32(&frame.bytes[5]);
    received = 0;
    runningCRC = 0xFFFFFFFFUL;
    if (!expectedSize || !Update.begin(expectedSize, U_FLASH)) {
      Serial.printf("Update.begin failed: %u\n", Update.getError());
      atech::coreReleaseOta("ble");
      notifyStatus(0xE2, 0);
      return;
    }
    updating = true;
    lastActivityMs = millis();
    // The generated app must not touch the LED or compete for CPU while flash
    // is being written. It resumes only if the update aborts.
    atech::coreSuspendApp();
    Serial.printf("OTA START %lu bytes\n", (unsigned long)expectedSize);
    notifyStatus(0x10, 0); // READY
  } else if (opcode == 0x02 && frame.length == 1) { // FINISH
    if (!updating || received != expectedSize ||
        (runningCRC ^ 0xFFFFFFFFUL) != expectedCRC) {
      Serial.println("OTA length or CRC mismatch");
      abortUpdate(0xE3);
      return;
    }
    if (!Update.end()) {
      Serial.printf("Update.end failed: %u\n", Update.getError());
      abortUpdate(0xE4);
      return;
    }
    updating = false;
    Serial.println("OTA image activated; rebooting for version verification");
    notifyStatus(0x12, received); // TRANSFER_DONE, not post-boot verified
    delay(900);
    ESP.restart();
  } else if (opcode == 0x03 && frame.length == 1) { // ABORT
    abortUpdate(0xE5);
  } else {
    notifyStatus(0xE6, received);
  }
}

void handleData(const Frame &frame) {
  if (!updating || received + frame.length > expectedSize) {
    notifyStatus(0xE7, received);
    return;
  }
  // Reject an image for another chip before committing its first bytes.
  if (received == 0 &&
      (frame.length < 14 || frame.bytes[0] != 0xE9 ||
       le16(&frame.bytes[12]) != ESP32_S3_CHIP_ID)) {
    Serial.println("OTA image is not an ESP32-S3 application image");
    abortUpdate(0xE9);
    return;
  }
  if (Update.write(const_cast<uint8_t *>(frame.bytes), frame.length) != frame.length) {
    Serial.printf("Update.write failed: %u\n", Update.getError());
    abortUpdate(0xE8);
    return;
  }
  runningCRC = crc32Update(runningCRC, frame.bytes, frame.length);
  received += frame.length;
  lastActivityMs = millis();
  notifyStatus(0x11, received); // ACK after flash write
}

void handleCommand(const Frame &frame) {
  const uint32_t requestId = frame.length >= 5 ? le32(&frame.bytes[1]) : 0;
  const uint8_t opcode = frame.length >= 6 ? frame.bytes[5] : 0;
  uint8_t nonce[8] = {};
  if (frame.length >= 14) memcpy(nonce, &frame.bytes[6], sizeof(nonce));

  if (frame.length != COMMAND_PACKET_SIZE ||
      frame.bytes[0] != COMMAND_PROTOCOL_VERSION) {
    notifyCommandResponse(requestId, opcode, CommandStatus::Malformed, nonce);
    return;
  }
  if (le16(&frame.bytes[18]) != crc16(frame.bytes, 18)) {
    notifyCommandResponse(requestId, opcode, CommandStatus::CrcError, nonce);
    return;
  }
  if (otaTransportBusy()) {
    notifyCommandResponse(requestId, opcode, CommandStatus::Busy, nonce);
    return;
  }

  CommandStatus status = CommandStatus::Ok;
  switch (static_cast<CommandOpcode>(opcode)) {
    case CommandOpcode::Ping:
    case CommandOpcode::GetStatus:
      break;
    case CommandOpcode::BlinkBlue:
      atech::setLedOwner(atech::LedOwner::BlinkBlue);
      break;
    case CommandOpcode::BlinkGreen:
      atech::setLedOwner(atech::LedOwner::BlinkGreen);
      break;
    case CommandOpcode::StopBlinking:
      atech::setLedOwner(atech::LedOwner::Off);
      break;
    case CommandOpcode::ResumeApp:
      atech::setLedOwner(atech::LedOwner::App);
      break;
    default:
      status = CommandStatus::Unsupported;
      break;
  }

  Serial.printf("Command request=%lu opcode=0x%02x status=%u\n",
                (unsigned long)requestId, opcode, static_cast<unsigned>(status));
  notifyCommandResponse(requestId, opcode, status, nonce);
}

void setup() {
  Serial.begin(115200);

  AtechCoreConfig coreConfig = {};
  coreConfig.demo = 1;
  coreConfig.board = "esp32-s3-devkitc-1";
  coreConfig.variant = "N16R8";
  coreConfig.firmwareInfo = FIRMWARE_INFO;
  coreConfig.buildId = BUILD_MARKER + sizeof("ATECH-BUILD:") - 1; // id after the marker prefix
  coreConfig.appName = ATECH_APP_NAME;
  coreConfig.appVersion = ATECH_APP_VERSION;
  coreConfig.targetDeviceId = TARGET_MARKER + sizeof("ATECH-TARGET:") - 1; // id after the marker prefix
  coreConfig.ledPin = LED_PIN;
  coreConfig.autoConfirmMs = AUTO_CONFIRM_MS;
  coreConfig.otaBusy = otaTransportBusy;
  coreConfig.holdAutoConfirm = cloudHoldsConfirm;
  if (!atech::coreBegin(coreConfig)) {
    Serial.println("Atech core initialization failed");
  }

  incoming = xQueueCreate(8, sizeof(Frame));
  if (!incoming) { Serial.println("Queue allocation failed"); abort(); }

  bleDeviceName = atech::bleName(BLE_NAME_PREFIX);
  BLEDevice::init(bleDeviceName);
  BLEDevice::setMTU(247);
  bleServer = BLEDevice::createServer();
  bleServer->setCallbacks(new ConnectionCallbacks());
  BLEService *service = bleServer->createService(SERVICE_UUID);

  BLECharacteristic *control = service->createCharacteristic(
      CONTROL_UUID, BLECharacteristic::PROPERTY_WRITE);
  control->setCallbacks(new InputCallbacks(FrameKind::OtaControl));

  BLECharacteristic *data = service->createCharacteristic(
      DATA_UUID, BLECharacteristic::PROPERTY_WRITE);
  data->setCallbacks(new InputCallbacks(FrameKind::OtaData));

  statusCharacteristic = service->createCharacteristic(
      STATUS_UUID, BLECharacteristic::PROPERTY_NOTIFY | BLECharacteristic::PROPERTY_READ);

  BLECharacteristic *info = service->createCharacteristic(
      INFO_UUID, BLECharacteristic::PROPERTY_READ);
  info->setValue(FIRMWARE_INFO);

  BLECharacteristic *command = service->createCharacteristic(
      COMMAND_UUID, BLECharacteristic::PROPERTY_WRITE);
  command->setCallbacks(new InputCallbacks(FrameKind::Command));

  responseCharacteristic = service->createCharacteristic(
      RESPONSE_UUID, BLECharacteristic::PROPERTY_NOTIFY | BLECharacteristic::PROPERTY_READ);

#if defined(CONFIG_BLUEDROID_ENABLED)
  statusCharacteristic->addDescriptor(new BLE2902());
  responseCharacteristic->addDescriptor(new BLE2902());
#endif

  service->start();
  // Identity, control and event characteristics shared with Demo 2.
  atech::coreAttachBle(bleServer);
  BLEAdvertising *advertising = BLEDevice::getAdvertising();
  advertising->addServiceUUID(SERVICE_UUID);
  advertising->setScanResponse(true);

  // Station-mode Wi-Fi, mDNS and the authenticated LAN OTA service. Started
  // before the hotspot portal so the portal can arbitrate the radio mode.
  AtechWifiLanConfig lanConfig = {};
  lanConfig.demo = 1;
  lanConfig.imageIdentity = WIFI_OTA_IMAGE_IDENTITY;
  lanConfig.preferencesNamespace = "atech_wifi";
  lanConfig.firmwareVersion = FIRMWARE_INFO;
  lanConfig.hostnamePrefix = "atech";
  lanConfig.port = WIFI_LAN_PORT;
  lanConfig.rebootDelayMs = 1500;
  lanConfig.authToken = lanAuthToken;
  lanConfig.otherOtaBusy = lanBlockedByOthers;
  lanConfig.extraIdentity = cloudIdentity;
  if (!wifiLan.begin(lanConfig)) {
    Serial.printf("Wi-Fi LAN service initialization failed: %s\n", wifiLan.lastError().c_str());
  }

  // Cloud OTA agent: outbound HTTPS to the builder backend, device-pulled deployments.
  AtechCloudOtaConfig cloudConfig = {};
  cloudConfig.demo = 1;
  cloudConfig.imageIdentity = WIFI_OTA_IMAGE_IDENTITY;
  cloudConfig.preferencesNamespace = "atech_cloud";
  cloudConfig.firmwareVersion = FIRMWARE_INFO;
  cloudConfig.appName = ATECH_APP_NAME;
  cloudConfig.appVersion = ATECH_APP_VERSION;
  cloudConfig.defaultUrl = ATECH_CLOUD_URL;
  cloudConfig.allowInsecureHttp = ATECH_CLOUD_ALLOW_HTTP != 0;
  cloudConfig.pollIntervalMs = 15000;
  cloudConfig.confirmTimeoutMs = 180000;
  cloudConfig.chunkBytes = 131072;
  cloudConfig.authToken = lanAuthToken;
  cloudConfig.otherOtaBusy = cloudBlockedByOthers;
  cloudConfig.wifiConnected = homeWifiConnected;
  if (!cloudOta.begin(cloudConfig)) {
    Serial.printf("Cloud OTA agent initialization failed: %s\n", cloudOta.lastError().c_str());
  }

  AtechWifiOtaConfig wifiOtaConfig = {};
  wifiOtaConfig.lan = &wifiLan;
  wifiOtaConfig.cloud = &cloudOta;
  wifiOtaConfig.deviceName = bleDeviceName.c_str();
  wifiOtaConfig.firmwareVersion = FIRMWARE_INFO;
  wifiOtaConfig.ssidPrefix = "Atech-OTA-D1";
  wifiOtaConfig.imageIdentity = WIFI_OTA_IMAGE_IDENTITY;
  wifiOtaConfig.preferencesNamespace = "atech_ota_d1";
  wifiOtaConfig.apPasswordOverride = ATECH_WIFI_AP_PASSWORD;
  wifiOtaConfig.otaTokenOverride = ATECH_WIFI_OTA_TOKEN;
  wifiOtaConfig.buttonPin = WIFI_OTA_BUTTON_PIN;
  wifiOtaConfig.buttonActiveLow = true;
  wifiOtaConfig.buttonHoldMs = WIFI_OTA_BUTTON_HOLD_MS;
  wifiOtaConfig.inactivityTimeoutMs = WIFI_OTA_INACTIVITY_TIMEOUT_MS;
  wifiOtaConfig.rebootDelayMs = 2200;
  wifiOtaConfig.otherOtaBusy = bleBlocksWifiOta;
  wifiOtaConfig.modeChanged = handleWifiOtaModeChanged;
  if (!wifiOta.begin(wifiOtaConfig)) {
    Serial.printf("Wi-Fi OTA initialization failed: %s\n",
                  wifiOta.lastError().c_str());
  }
  if (!wifiOta.isActive()) BLEDevice::startAdvertising();
  Serial.printf("Atech BLE command + OTA firmware ready: %s (%s, %s)\n",
                FIRMWARE_INFO, BUILD_MARKER, TARGET_MARKER);
}

void loop() {
  wifiLan.loop();
  wifiOta.loop();
  cloudOta.loop();
  // A LAN or cloud transfer pauses advertising (not a connected client) so the
  // radio favours Wi-Fi, and resumes it afterwards unless the hotspot owns BLE.
  const bool lanTransfer = wifiLan.isTransferring() || cloudOta.isTransferring();
  if (lanTransfer != lanTransferWasActive) {
    lanTransferWasActive = lanTransfer;
    if (bleServer) {
      if (lanTransfer) { if (!deviceConnected) BLEDevice::stopAdvertising(); }
      else if (!deviceConnected && !wifiOtaModeActive) bleServer->startAdvertising();
    }
  }
  // The app pauses only while a Wi-Fi upload is actually streaming into flash,
  // so a pending image can still prove itself (and be confirmed) while the
  // portal stays up for post-reboot verification.
  const bool wifiUploading = wifiOta.isUpdating();
  if (wifiUploading && !wifiUploadWasActive) atech::coreSuspendApp();
  if (!wifiUploading && wifiUploadWasActive && !updating) atech::coreResumeApp();
  wifiUploadWasActive = wifiUploading;
  atech::coreLoop();

  if (disconnectPending) {
    disconnectPending = false;
    if (updating) {
      Serial.printf("OTA aborted after disconnect at %lu bytes\n",
                    (unsigned long)received);
      abortUpdate(0xE0, false);
    }
    xQueueReset(incoming);
  }

  Frame frame;
  // BLE callbacks only enqueue. The main loop owns commands and flash writes.
  if (xQueueReceive(incoming, &frame, 0) == pdTRUE) {
    switch (frame.kind) {
      case FrameKind::OtaControl: handleControl(frame); break;
      case FrameKind::OtaData: handleData(frame); break;
      case FrameKind::Command: handleCommand(frame); break;
    }
  }

  if (updating && millis() - lastActivityMs > OTA_IDLE_TIMEOUT_MS) {
    Serial.printf("OTA timed out at %lu bytes\n", (unsigned long)received);
    abortUpdate(0xEA);
  }
  if (!wifiOtaModeActive && !deviceConnected && previouslyConnected && !lanTransferWasActive) {
    delay(250);
    bleServer->startAdvertising();
  }
  previouslyConnected = deviceConnected;

  delay(updating ? 1 : 20);
}
